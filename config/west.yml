## config/west.yml
```yaml
manifest:
  remotes:
      # zmk official
    - name: zmkfirmware
      url-base: https://github.com/zmkfirmware
    # - name: gpeye                         
    #   url-base: https://github.com/GPeye 
    # # Additional modules containing boards/shields/custom code can be listed here as well
    # # See https://docs.zephyrproject.org/3.2.0/develop/west/manifest.html#projects
    - name: urob
      url-base: https://github.com/urob
    - name: dsifry #new entry
      url-base: https://github.com/dsifry #new entry
  projects:
    - name: zmk
      remote: zmkfirmware
      revision: main
      import: app/west.yml
    # - name: urchin-peripheral-animation
    #   remote: gpeye                      
    #   revision: main                     
    - name: zmk-helpers
      remote: urob
      revision: main
    - name: zmk-adaptive-key
      remote: urob
      revision: main
    - name: zmk-auto-layer
      remote: urob
      revision: main
    - name: zmk-leader-key
      remote: urob
      revision: main
    - name: zmk-tri-state
      remote: urob
      revision: main
    - name: nice-view-mod #new entry
      remote: dsifry #new entry
      revision: main #new entry
  self:
    path: config
```
